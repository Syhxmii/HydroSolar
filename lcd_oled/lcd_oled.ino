#include <SPI.h>
#include <U8g2lib.h>
#include "ezButton.h"  // The library to use for SW pin

// LCD

const int LCDE = 6;
const int LCDRS = 7;
const int LCD4 = 5;

int progress = 1;
char buffer[32];
U8G2_ST7920_128X64_F_SW_SPI lcd(U8G2_R0,  14, 13, 15, U8X8_PIN_NONE);

// 'icon_3dcube', 16x16px
const unsigned char bitmap_icon_3dcube [] PROGMEM = {
  0x00, 0x00, 0x01, 0x80, 0x07, 0x60, 0x19, 0x18, 0x61, 0x06, 0x51, 0x0a, 0x45, 0xa2, 0x41, 0x02, 
  0x45, 0x22, 0x41, 0x02, 0x45, 0xa2, 0x51, 0x0a, 0x61, 0x06, 0x19, 0x18, 0x07, 0x60, 0x01, 0x80
};
// 'icon_battery', 16x16px
const unsigned char bitmap_icon_battery [] PROGMEM = {
  0x00, 0x00, 0x00, 0x00, 0x00, 0x00, 0x00, 0x00, 0x3f, 0xf8, 0x40, 0x04, 0x5b, 0x66, 0x5b, 0x66, 
  0x5b, 0x66, 0x40, 0x04, 0x3f, 0xf8, 0x00, 0x00, 0x00, 0x00, 0x00, 0x00, 0x00, 0x00, 0x00, 0x00
};
// 'icon_dashboard', 16x16px
const unsigned char bitmap_icon_dashboard [] PROGMEM = {
  0x07, 0xe0, 0x18, 0x18, 0x21, 0x24, 0x50, 0x02, 0x48, 0x0a, 0x84, 0x01, 0x83, 0x81, 0xa2, 0x45, 
  0x82, 0x41, 0x81, 0x81, 0xa0, 0x05, 0x40, 0x02, 0x4b, 0xd2, 0x23, 0xc4, 0x18, 0x18, 0x07, 0xe0
};
// 'icon_fireworks', 16x16px
const unsigned char bitmap_icon_fireworks [] PROGMEM = {
  0x00, 0x00, 0x00, 0x08, 0x00, 0x94, 0x10, 0x08, 0x10, 0x00, 0x6c, 0x00, 0x10, 0x10, 0x10, 0x10, 
  0x00, 0x00, 0x00, 0xc6, 0x00, 0x00, 0x00, 0x10, 0x04, 0x10, 0x0a, 0x00, 0x04, 0x00, 0x00, 0x00
};
// 'icon_gps_speed', 16x16px
const unsigned char bitmap_icon_gps_speed [] PROGMEM = {
  0x00, 0x00, 0x03, 0xf0, 0x00, 0x08, 0x01, 0xe4, 0x00, 0x12, 0x00, 0xca, 0x06, 0x2a, 0x07, 0x2a, 
  0x07, 0x8a, 0x07, 0xc2, 0x07, 0xc0, 0x0a, 0x00, 0x1f, 0x00, 0x20, 0x80, 0x7f, 0xc0, 0x00, 0x00
};
// 'icon_knob_over_oled', 16x16px
const unsigned char bitmap_icon_knob_over_oled [] PROGMEM = {
  0x00, 0x00, 0x1f, 0xf0, 0x13, 0x50, 0x1b, 0xb0, 0x11, 0x50, 0x1f, 0xf0, 0x03, 0x80, 0x01, 0x00, 
  0x00, 0x00, 0x09, 0x20, 0x49, 0x24, 0x20, 0x08, 0x00, 0x01, 0x80, 0x02, 0x00, 0x00, 0x00, 0x00
};
// 'icon_parksensor', 16x16px
const unsigned char bitmap_icon_parksensor [] PROGMEM = {
  0x00, 0x00, 0x00, 0x00, 0x00, 0x00, 0xfc, 0x00, 0x22, 0x00, 0x25, 0x00, 0xf9, 0x00, 0x00, 0x81, 
  0x0c, 0x85, 0x12, 0x95, 0xd2, 0x95, 0x0c, 0x05, 0x00, 0x01, 0x00, 0x00, 0x00, 0x00, 0x00, 0x00
};
// 'icon_turbo', 16x16px
const unsigned char bitmap_icon_turbo [] PROGMEM = {
  0x00, 0x0e, 0x07, 0xf1, 0x18, 0x01, 0x20, 0x01, 0x40, 0x01, 0x43, 0xf1, 0x84, 0x4e, 0x8a, 0xa0, 
  0x89, 0x22, 0x8a, 0xa2, 0x84, 0x42, 0x43, 0x84, 0x40, 0x04, 0x20, 0x08, 0x18, 0x30, 0x07, 0xc0
};

// Array of all bitmaps for convenience. (Total bytes used to store images in PROGMEM = 384)
const unsigned char* bitmap_icons[8] = {
  bitmap_icon_3dcube,
  bitmap_icon_battery,
  bitmap_icon_dashboard,
  bitmap_icon_fireworks,
  bitmap_icon_gps_speed,
  bitmap_icon_knob_over_oled,
  bitmap_icon_parksensor,
  bitmap_icon_turbo
};


// 'scrollbar_background', 8x64px
const unsigned char bitmap_scrollbar_background [] PROGMEM = {
  0x00, 0x02, 0x00, 0x02, 0x00, 0x02, 0x00, 0x02, 0x00, 0x02, 0x00, 0x02, 0x00, 0x02, 0x00, 0x02, 
  0x00, 0x02, 0x00, 0x02, 0x00, 0x02, 0x00, 0x02, 0x00, 0x02, 0x00, 0x02, 0x00, 0x02, 0x00, 0x02, 
  0x00, 0x02, 0x00, 0x02, 0x00, 0x02, 0x00, 0x02, 0x00, 0x02, 0x00, 0x02, 0x00, 0x02, 0x00, 0x02, 
  0x00, 0x02, 0x00, 0x02, 0x00, 0x02, 0x00, 0x02, 0x00, 0x02, 0x00, 0x02, 0x00, 0x02, 0x00, 0x00
};

// 'item_sel_outline', 128x21px
const unsigned char bitmap_item_sel_outline [] PROGMEM = {
  0x1f, 0xff, 0xff, 0xff, 0xff, 0xff, 0xff, 0xff, 0xff, 0xff, 0xff, 0xff, 0xff, 0xff, 0xff, 0xc0, 
  0x20, 0x00, 0x00, 0x00, 0x00, 0x00, 0x00, 0x00, 0x00, 0x00, 0x00, 0x00, 0x00, 0x00, 0x00, 0x20, 
  0x40, 0x00, 0x00, 0x00, 0x00, 0x00, 0x00, 0x00, 0x00, 0x00, 0x00, 0x00, 0x00, 0x00, 0x00, 0x30, 
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  0x1f, 0xff, 0xff, 0xff, 0xff, 0xff, 0xff, 0xff, 0xff, 0xff, 0xff, 0xff, 0xff, 0xff, 0xff, 0xc0
};

const int NUM_ITEMS = 8;
const int MAX_ITEM_LENGTH = 20;
char menu_items[NUM_ITEMS][MAX_ITEM_LENGTH] = {
  {"Mulai Sterilisasi"},
  {"Durasi Ozoniasi"},
  {"Standby UV"},
  {"Mode"},
  {"Monitoring"}, 
  {"Big Knob"}, 
  {"Park Sensor"},
  {"Turbo Gauge"},
};


int item_selected = 0; // which item in the menu is selected

int item_sel_previous; // previous item - used in the menu screen to draw the item before the selected one
int item_sel_next; // next item - used in the menu screen to draw next item after the selected one

int current_screen = 0;   // 0 = menu, 1 = screenshot, 2 = qr



// Button
#define CLK_PIN D3  // The ESP8266 pin D7 connected to the rotary encoder's CLK pin
#define DT_PIN D2   // The ESP8266 pin D6 connected to the rotary encoder's DT pin
#define SW_PIN D1   // The ESP8266 pin D5 connected to the rotary encoder's SW pin

#define DIRECTION_CW 0   // clockwise direction
#define DIRECTION_CCW 1  // counter-clockwise direction


volatile int counter = 0;
volatile int direction = DIRECTION_CW;
volatile unsigned long last_time;  // for debouncing
int prev_counter;

ezButton button(SW_PIN);  // create ezButton object for pin 7;

void ICACHE_RAM_ATTR INTERRUPT_handler() {
  if ((millis() - last_time) < 50)  // debounce time is 50ms
    return;


  if (digitalRead(DT_PIN) == HIGH) {
    // The encoder is rotating in counter-clockwise direction => decrease the counter
    counter--;
    direction = DIRECTION_CCW;
  } else {
    // The encoder is rotating in clockwise direction => increase the counter
    counter++;
    direction = DIRECTION_CW;
  }

  last_time = millis();
}

void setup() {
  Serial.begin(9600);

  pinMode(CLK_PIN, INPUT_PULLUP);
  pinMode(DT_PIN, INPUT_PULLUP);
  button.setDebounceTime(50);  // set debounce time to 50 milliseconds

  attachInterrupt(digitalPinToInterrupt(CLK_PIN), INTERRUPT_handler, RISING);

  lcd.begin();
  lcd.clearBuffer();
  lcd.setFontMode(1);
  lcd.setBitmapMode(1);
  lcd.setFont(u8g2_font_helvB08_tr);
}

void loop() {
  lcd.clearBuffer();
  button.loop();  // MUST call the loop() function first
  // loadingScreen()
  buttonOnChange();
  lcd.sendBuffer();
}
void buttonOnChange(){
  
  if (prev_counter != counter) {
    if (direction == DIRECTION_CW)
    {
      item_selected = item_selected - 1;
      if(item_selected < 0){
        item_selected = NUM_ITEMS-1;
      }
    }
    else
    {
      item_selected = item_selected + 1;
      if(item_selected >= NUM_ITEMS){
        item_selected = 0;
      }
    }
  }

    item_sel_previous = item_selected - 1;
    if(item_sel_previous < 0) {item_sel_previous = NUM_ITEMS - 1;}      
    item_sel_next = item_selected + 1;
    if(item_sel_next >= NUM_ITEMS) {item_sel_next = 0;}
    // prev_counter = counter;

    lcd.firstPage();
    do{
      if(current_screen == 0){
        lcd.drawXBMP(0, 22, 128, 21, bitmap_item_sel_outline);

        lcd.setFont(u8g_font_7x14);
        lcd.drawStr(25, 15, menu_items[item_sel_previous]);
        lcd.drawXBMP(4, 2, 16, 16, bitmap_icons[item_sel_previous]);

        lcd.setFont(u8g_font_7x14B);
        lcd.drawStr(25, 15+20+2, menu_items[item_selected]);
        lcd.drawXBMP(4, 24, 16, 16, bitmap_icons[item_selected]);

        lcd.setFont(u8g_font_7x14);
        lcd.drawStr(25, 15+20+20+2, menu_items[item_sel_next]);
        lcd.drawXBMP(4, 46, 16, 16, bitmap_icons[item_sel_next]);

        lcd.drawXBMP(128-8, 0, 8,64, bitmap_scrollbar_background);
        lcd.drawBox(125, 64/NUM_ITEMS * item_selected, 3, 64/NUM_ITEMS);
      }
    }while(lcd.nextPage());

  if (button.isPressed()) {
    Serial.println("The button is pressed");
  }
}
void loadingScreen(){
  lcd.drawFrame(14, 21, 104, 18);
  lcd.drawStr(9, 12, "Loading Screen");
  lcd.drawLine(6, 15, 120, 15);
  sprintf(buffer, "Progress: %d%%", progress);
  lcd.drawStr(30, 54, buffer);
  lcd.drawBox(16, 23, progress, 14);
  Serial.println(progress);
  delay(200);
  if(progress < 100){
      progress++;
  }
}


